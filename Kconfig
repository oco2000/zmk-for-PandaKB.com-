## Kconfig
```kconfig
menuconfig ZMK_PERKEY_RGB
	bool "Per-key RGB indicators (replaces ZMK_RGB_UNDERGLOW)"
	select LED_STRIP
	select ZMK_LOW_PRIORITY_WORK_QUEUE
	# ZMK only defaults SPI on for its own underglow (app/Kconfig.defaults),
	# and the ws2812-spi driver needs it.
	select SPI
	help
	  Owns the whole addressable strip on this half and paints each LED
	  according to the key it sits under. Requires CONFIG_ZMK_RGB_UNDERGLOW=n,
	  since stock underglow rewrites every pixel every 50ms.

if ZMK_PERKEY_RGB

config ZMK_PERKEY_RGB_BRT_MAX
	int "Maximum brightness percent"
	default 60
	range 1 100
	help
	  Hard ceiling applied to every colour, for the power budget.

config ZMK_PERKEY_RGB_BRT_START
	int "Brightness percent at first boot"
	default 60
	range 0 100

config ZMK_PERKEY_RGB_BRT_STEP
	int "Brightness percent per step"
	default 10
	range 1 100

config ZMK_PERKEY_RGB_ON_START
	bool "Start with the LEDs on"
	default y

config ZMK_PERKEY_RGB_AUTO_OFF_IDLE
	bool "Blank the LEDs when the keyboard goes idle"
	default y

config ZMK_PERKEY_RGB_COALESCE_MS
	int "Coalescing window before repainting"
	default 10
	help
	  State changes arriving within this window produce a single repaint.

config ZMK_PERKEY_RGB_MIN_INTERVAL_MS
	int "Minimum interval between strip updates"
	default 30
	help
	  Rate limit. Driving 27 LEDs costs roughly 1.3ms of SPI, so unbounded
	  repainting would burn more power than stock underglow's 20Hz tick.

config ZMK_PERKEY_RGB_CHASE
	bool "Diagnostic: walk a single lit LED along the strip"
	help
	  Lights one LED at a time, stepping along the physical chain, and logs
	  the index. Used to discover the real LED order and count. Overrides all
	  normal rendering.

config ZMK_PERKEY_RGB_CHASE_MS
	int "Milliseconds per LED in chase mode"
	default 2000
	depends on ZMK_PERKEY_RGB_CHASE

endif # ZMK_PERKEY_RGB
```

## dts/bindings/behaviors/zmk,behavior-perkey-rgb-sync.yaml
```yaml
# SPDX-License-Identifier: MIT

description: |
  Internal: carries per-key RGB state from the central to the peripherals.
  Not meant to be bound to a key.

compatible: "zmk,behavior-perkey-rgb-sync"

include: two_param.yaml
```

## dts/bindings/behaviors/zmk,behavior-perkey-rgb.yaml
```yaml
# SPDX-License-Identifier: MIT

description: Per-key RGB control (on/off and brightness).

compatible: "zmk,behavior-perkey-rgb"

include: two_param.yaml
```

## dts/bindings/zmk,perkey-rgb-map.yaml
```yaml
# SPDX-License-Identifier: MIT

description: |
  Maps each LED of the zmk,underglow strip to a key position, per half.

  This is a hardware description and belongs in the shield, not the keymap.
  Both halves' arrays are declared here and "side" selects which one this
  firmware renders.

compatible: "zmk,perkey-rgb-map"

properties:
  side:
    type: string
    required: true
    enum:
      - "left"
      - "right"
    description: Which of the two arrays this firmware renders.

  left-leds:
    type: array
    required: true
    description: |
      One entry per strip LED, in strip order. Each value is a key position
      (see dt-bindings/zmk/corne_positions.h) or PRGB_UG for an LED that does
      not sit under a key. Length must equal the strip's chain-length.

  right-leds:
    type: array
    required: true
    description: Same as left-leds, for the right half.
```

## dts/bindings/zmk,perkey-rgb-zone.yaml
```yaml
# SPDX-License-Identifier: MIT

description: |
  A named set of key positions that a layer can colour differently.

  The colour lives at the reference, not here, so the same set can be reused on
  several layers with a different colour each time:

      zones = <&prgb_numpad 200 100 90>;

compatible: "zmk,perkey-rgb-zone"

zone-cells:
  - hue
  - saturation
  - value

properties:
  "#zone-cells":
    type: int
    required: true
    const: 3

  positions:
    type: array
    required: true
    description: Key positions (see dt-bindings/zmk/corne_positions.h).
```

## dts/bindings/zmk,perkey-rgb.yaml
```yaml
# SPDX-License-Identifier: MIT

description: |
  Per-key RGB indicator colours.

  Every colour is <hue saturation value> with hue 0-359 and saturation and
  value 0-100. Value is scaled by the runtime brightness and by
  CONFIG_ZMK_PERKEY_RGB_BRT_MAX before it reaches the LEDs.

  Each child node describes one layer. Layers are matched by their "layer"
  property rather than by child order, so inserting a layer cannot silently
  shift every colour.

compatible: "zmk,perkey-rgb"

properties:
  default-color:
    type: array
    required: true
    description: Colour for a key on a layer with no entry of its own.

  underglow-color:
    type: array
    required: true
    description: |
      Colour for LEDs mapped to PRGB_UG, used only when the active layer has
      no entry below. Otherwise those LEDs follow the layer's own colour.

  unbound-value:
    type: int
    required: true
    description: |
      Value (0-100) for a key that is &trans or &none on the active layer. It
      keeps the layer's hue and saturation, so an unbound key reads as a dark
      version of the layer rather than a different colour.

  modifier-color:
    type: array
    required: true
    description: Colour for a key that holds a bare modifier on the active layer.

  pressed-color:
    type: array
    required: false
    description: |
      Colour for a key while it is physically held. Omit to disable press
      feedback entirely, which means an ordinary typing session emits no LED
      updates at all. Mainly a diagnostic for verifying the LED map.

child-binding:
  description: Colours for one layer.

  properties:
    layer:
      type: int
      required: true
      description: Layer index this entry describes.

    color:
      type: array
      required: true
      description: Base colour for keys on this layer.

    underglow-color:
      type: array
      required: false
      description: |
        Colour for the PRGB_UG LEDs on this layer. Defaults to this layer's
        "color", so the underglow follows the layer unless told otherwise.

    zones:
      type: phandle-array
      required: false
      description: |
        Zones to paint on this layer, each followed by its hue, saturation and
        value. The first zone naming a given position wins.
```

## dts/bindings/zmk,underglow-indicators.yaml
```yaml
# SPDX-License-Identifier: MIT

description: |
  Underglow color indicators.

  Sets the underglow hue/saturation from the highest active layer, and applies
  mod-color instead while a modifier is held on the base layer. Brightness and
  on/off state are never modified.

compatible: "zmk,underglow-indicators"

properties:
  layer-colors:
    type: array
    required: true
    description: |
      Hue/saturation pairs, one per keymap layer, in layer order. Hue is
      0-360, saturation 0-100. Layers without an entry are left untouched.

  mod-color:
    type: array
    required: true
    description: |
      Hue/saturation pair used while a modifier is held on the base layer.
```
